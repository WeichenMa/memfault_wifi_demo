## zephyrmemfault/build/Kconfig/Kconfig.modules
```kconfig
menu "nrf (D:/ESE5180codeFolder/fp-f24-iot-venture-pitch-easypark/memfault_wifi_demo/zephyrmemfault/nrf)"
osource "D:/ESE5180codeFolder/fp-f24-iot-venture-pitch-easypark/memfault_wifi_demo/zephyrmemfault/nrf/Kconfig.nrf"
config ZEPHYR_NRF_MODULE
	bool
	default y
endmenu
menu "hostap (D:/ESE5180codeFolder/fp-f24-iot-venture-pitch-easypark/memfault_wifi_demo/zephyrmemfault/modules/lib/hostap)"
osource "D:/ESE5180codeFolder/fp-f24-iot-venture-pitch-easypark/memfault_wifi_demo/zephyrmemfault/modules/lib/hostap/zephyr/Kconfig"
config ZEPHYR_HOSTAP_MODULE
	bool
	default y
endmenu
menu "mcuboot (D:/ESE5180codeFolder/fp-f24-iot-venture-pitch-easypark/memfault_wifi_demo/zephyrmemfault/bootloader/mcuboot)"
osource "$(ZEPHYR_MCUBOOT_KCONFIG)"
config ZEPHYR_MCUBOOT_MODULE
	bool
	default y
endmenu
menu "mbedtls (D:/ESE5180codeFolder/fp-f24-iot-venture-pitch-easypark/memfault_wifi_demo/zephyrmemfault/modules/crypto/mbedtls)"
osource "$(ZEPHYR_MBEDTLS_KCONFIG)"
config ZEPHYR_MBEDTLS_MODULE
	bool
	default y
endmenu
menu "trusted-firmware-m (D:/ESE5180codeFolder/fp-f24-iot-venture-pitch-easypark/memfault_wifi_demo/zephyrmemfault/modules/tee/tf-m/trusted-firmware-m)"
osource "$(ZEPHYR_TRUSTED_FIRMWARE_M_KCONFIG)"
config ZEPHYR_TRUSTED_FIRMWARE_M_MODULE
	bool
	default y
endmenu
menu "cjson (D:/ESE5180codeFolder/fp-f24-iot-venture-pitch-easypark/memfault_wifi_demo/zephyrmemfault/modules/lib/cjson)"
osource "$(ZEPHYR_CJSON_KCONFIG)"
config ZEPHYR_CJSON_MODULE
	bool
	default y
endmenu
menu "azure-sdk-for-c (D:/ESE5180codeFolder/fp-f24-iot-venture-pitch-easypark/memfault_wifi_demo/zephyrmemfault/modules/lib/azure-sdk-for-c)"
osource "$(ZEPHYR_AZURE_SDK_FOR_C_KCONFIG)"
config ZEPHYR_AZURE_SDK_FOR_C_MODULE
	bool
	default y
endmenu
menu "cirrus-logic (D:/ESE5180codeFolder/fp-f24-iot-venture-pitch-easypark/memfault_wifi_demo/zephyrmemfault/modules/hal/cirrus-logic)"
osource "D:/ESE5180codeFolder/fp-f24-iot-venture-pitch-easypark/memfault_wifi_demo/zephyrmemfault/modules/hal/cirrus-logic/Kconfig"
config ZEPHYR_CIRRUS_LOGIC_MODULE
	bool
	default y
endmenu
menu "openthread (D:/ESE5180codeFolder/fp-f24-iot-venture-pitch-easypark/memfault_wifi_demo/zephyrmemfault/modules/lib/openthread)"
osource "$(ZEPHYR_OPENTHREAD_KCONFIG)"
config ZEPHYR_OPENTHREAD_MODULE
	bool
	default y
endmenu
menu "memfault-firmware-sdk (D:/ESE5180codeFolder/fp-f24-iot-venture-pitch-easypark/memfault_wifi_demo/zephyrmemfault/modules/lib/memfault-firmware-sdk)"
osource "D:/ESE5180codeFolder/fp-f24-iot-venture-pitch-easypark/memfault_wifi_demo/zephyrmemfault/modules/lib/memfault-firmware-sdk/ports/zephyr/Kconfig"
config ZEPHYR_MEMFAULT_FIRMWARE_SDK_MODULE
	bool
	default y
endmenu
menu "canopennode (D:/ESE5180codeFolder/fp-f24-iot-venture-pitch-easypark/memfault_wifi_demo/zephyrmemfault/modules/lib/canopennode)"
osource "$(ZEPHYR_CANOPENNODE_KCONFIG)"
config ZEPHYR_CANOPENNODE_MODULE
	bool
	default y
endmenu
menu "chre (D:/ESE5180codeFolder/fp-f24-iot-venture-pitch-easypark/memfault_wifi_demo/zephyrmemfault/modules/lib/chre)"
osource "D:/ESE5180codeFolder/fp-f24-iot-venture-pitch-easypark/memfault_wifi_demo/zephyrmemfault/modules/lib/chre/platform/zephyr/Kconfig"
config ZEPHYR_CHRE_MODULE
	bool
	default y
endmenu
menu "fatfs (D:/ESE5180codeFolder/fp-f24-iot-venture-pitch-easypark/memfault_wifi_demo/zephyrmemfault/modules/fs/fatfs)"
osource "$(ZEPHYR_FATFS_KCONFIG)"
config ZEPHYR_FATFS_MODULE
	bool
	default y
endmenu
menu "hal_nordic (D:/ESE5180codeFolder/fp-f24-iot-venture-pitch-easypark/memfault_wifi_demo/zephyrmemfault/modules/hal/nordic)"
osource "$(ZEPHYR_HAL_NORDIC_KCONFIG)"
config ZEPHYR_HAL_NORDIC_MODULE
	bool
	default y
endmenu
menu "liblc3 (D:/ESE5180codeFolder/fp-f24-iot-venture-pitch-easypark/memfault_wifi_demo/zephyrmemfault/modules/lib/liblc3)"
osource "$(ZEPHYR_LIBLC3_KCONFIG)"
config ZEPHYR_LIBLC3_MODULE
	bool
	default y
endmenu
menu "littlefs (D:/ESE5180codeFolder/fp-f24-iot-venture-pitch-easypark/memfault_wifi_demo/zephyrmemfault/modules/fs/littlefs)"
osource "$(ZEPHYR_LITTLEFS_KCONFIG)"
config ZEPHYR_LITTLEFS_MODULE
	bool
	default y
endmenu
menu "loramac-node (D:/ESE5180codeFolder/fp-f24-iot-venture-pitch-easypark/memfault_wifi_demo/zephyrmemfault/modules/lib/loramac-node)"
osource "$(ZEPHYR_LORAMAC_NODE_KCONFIG)"
config ZEPHYR_LORAMAC_NODE_MODULE
	bool
	default y
endmenu
menu "lvgl (D:/ESE5180codeFolder/fp-f24-iot-venture-pitch-easypark/memfault_wifi_demo/zephyrmemfault/modules/lib/gui/lvgl)"
osource "D:/ESE5180codeFolder/fp-f24-iot-venture-pitch-easypark/memfault_wifi_demo/zephyrmemfault/modules/lib/gui/lvgl/zephyr/Kconfig"
config ZEPHYR_LVGL_MODULE
	bool
	default y
endmenu
menu "lz4 (D:/ESE5180codeFolder/fp-f24-iot-venture-pitch-easypark/memfault_wifi_demo/zephyrmemfault/modules/lib/lz4)"
osource "$(ZEPHYR_LZ4_KCONFIG)"
config ZEPHYR_LZ4_MODULE
	bool
	default y
endmenu
menu "nanopb (D:/ESE5180codeFolder/fp-f24-iot-venture-pitch-easypark/memfault_wifi_demo/zephyrmemfault/modules/lib/nanopb)"
osource "$(ZEPHYR_NANOPB_KCONFIG)"
config ZEPHYR_NANOPB_MODULE
	bool
	default y
endmenu
menu "picolibc (D:/ESE5180codeFolder/fp-f24-iot-venture-pitch-easypark/memfault_wifi_demo/zephyrmemfault/modules/lib/picolibc)"
osource "D:/ESE5180codeFolder/fp-f24-iot-venture-pitch-easypark/memfault_wifi_demo/zephyrmemfault/modules/lib/picolibc/zephyr/Kconfig"
config ZEPHYR_PICOLIBC_MODULE
	bool
	default y
endmenu
menu "segger (D:/ESE5180codeFolder/fp-f24-iot-venture-pitch-easypark/memfault_wifi_demo/zephyrmemfault/modules/debug/segger)"
osource "$(ZEPHYR_SEGGER_KCONFIG)"
config ZEPHYR_SEGGER_MODULE
	bool
	default y
endmenu
menu "TraceRecorder (D:/ESE5180codeFolder/fp-f24-iot-venture-pitch-easypark/memfault_wifi_demo/zephyrmemfault/modules/debug/TraceRecorder)"
osource "D:/ESE5180codeFolder/fp-f24-iot-venture-pitch-easypark/memfault_wifi_demo/zephyrmemfault/modules/debug/TraceRecorder/kernelports/Zephyr/Kconfig"
config ZEPHYR_TRACERECORDER_MODULE
	bool
	default y
endmenu
menu "uoscore-uedhoc (D:/ESE5180codeFolder/fp-f24-iot-venture-pitch-easypark/memfault_wifi_demo/zephyrmemfault/modules/lib/uoscore-uedhoc)"
osource "$(ZEPHYR_UOSCORE_UEDHOC_KCONFIG)"
config ZEPHYR_UOSCORE_UEDHOC_MODULE
	bool
	default y
endmenu
menu "zcbor (D:/ESE5180codeFolder/fp-f24-iot-venture-pitch-easypark/memfault_wifi_demo/zephyrmemfault/modules/lib/zcbor)"
osource "$(ZEPHYR_ZCBOR_KCONFIG)"
config ZEPHYR_ZCBOR_MODULE
	bool
	default y
endmenu
menu "zscilib (D:/ESE5180codeFolder/fp-f24-iot-venture-pitch-easypark/memfault_wifi_demo/zephyrmemfault/modules/lib/zscilib)"
osource "D:/ESE5180codeFolder/fp-f24-iot-venture-pitch-easypark/memfault_wifi_demo/zephyrmemfault/modules/lib/zscilib/Kconfig.zscilib"
config ZEPHYR_ZSCILIB_MODULE
	bool
	default y
endmenu
menu "nrfxlib (D:/ESE5180codeFolder/fp-f24-iot-venture-pitch-easypark/memfault_wifi_demo/zephyrmemfault/nrfxlib)"
osource "D:/ESE5180codeFolder/fp-f24-iot-venture-pitch-easypark/memfault_wifi_demo/zephyrmemfault/nrfxlib/Kconfig.nrfxlib"
config ZEPHYR_NRFXLIB_MODULE
	bool
	default y
endmenu
menu "connectedhomeip (D:/ESE5180codeFolder/fp-f24-iot-venture-pitch-easypark/memfault_wifi_demo/zephyrmemfault/modules/lib/matter)"
osource "D:/ESE5180codeFolder/fp-f24-iot-venture-pitch-easypark/memfault_wifi_demo/zephyrmemfault/modules/lib/matter/config/nrfconnect/chip-module/Kconfig"
config ZEPHYR_CONNECTEDHOMEIP_MODULE
	bool
	default y
endmenu
```

## zephyrmemfault/build/Kconfig/Kconfig.shield.defconfig
```kconfig
osource "D:/ESE5180codeFolder/fp-f24-iot-venture-pitch-easypark/memfault_wifi_demo/zephyrmemfault/nrf/boards/shields/*/Kconfig.defconfig"
```
